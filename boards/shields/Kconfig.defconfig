## boards/shields/Kconfig.defconfig
```kconfig
# Copyright (c) 2022 ZMK Contributors
# SPDX-License-Identifier: MIT
 
 
if SHIELD_ERGOVISION_LEFT

config ZMK_KEYBOARD_NAME
	default "sofle_left"

endif

if SHIELD_ERGOVISION_RIGHT


config ZMK_SPLIT_BLE_ROLE_CENTRAL
	default y
	
endif

if SHIELD_ERGOVISION_LEFT || SHIELD_ERGOVISION_RIGHT

config ZMK_SPLIT
	default y
	
config ZMK_USB
	default y

config I2C 
	default y
endif
```

## boards/shields/Kconfig.shield
```kconfig
config SHIELD_SOFLE_NUMPAD
    def_bool $(shields_list_contains,sofle_numpad)
    
config SHIELD_ERGOVISION_LEFT
	def_bool $(shields_list_contains,ergovision_left)

config SHIELD_ERGOVISION_RIGHT
	def_bool $(shields_list_contains,ergovision_right)
```
